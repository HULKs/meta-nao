## conf/distro/Nao-OS.conf
```bitbake
require conf/distro/poky.conf

DISTRO = "Nao-OS"
DISTRO_NAME = "Nao-OS"
DISTRO_VERSION = "0.4"
SDK_NAME = "${DISTRO}"

hostname_pn-base-files = "nao"

LICENSE_FLAGS_WHITELIST = "commercial"

PREFERRED_PROVIDER_virtual/kernel = "linux-nao"
PREFERRED_PROVIDER_cgos-mod = "linux-nao"
PREFERRED_PROVIDER_lib32-cgos-mod = "linux-nao"

OS_RELEASE_FIELDS += "BUILD_ID"

DISTRO_FEATURES_remove = "x11 wayland 3g nfs nfc opengl vulkan bluetooth pcmcia"

DISTRO_FEATURES += "pam polkit"

KERNEL_MODULE_AUTOLOAD += "cgosdrv"

DISTRO_FEATURES_append = " systemd"
VIRTUAL-RUNTIME_init_manager = "systemd"
DISTRO_FEATURES_BACKFILL_CONSIDERED += "sysvinit"
VIRTUAL-RUNTIME_initscript = "systemd-compat-units"

IMAGE_FSTYPES = "ext3"

require conf/multilib.conf
MULTILIBS = "multilib:lib32"
DEFAULTTUNE_virtclass-multilib-lib32 = "x86"
```

## conf/distro/nao-core-minimal.conf
```bitbake
require conf/distro/poky.conf

DISTRO = "nao-core-minimal"
DISTRO_NAME = "nao-core-minimal"
DISTRO_VERSION = "2.0"
SDK_NAME = "${DISTRO}"
TARGET_VENDOR = "-aldebaran"
SDK_VENDOR = "-naosdk"
SDK_ARCHIVE_TYPE = "tar.zst"
MAINTAINER = "Team HULKs <hulks@tuhh.de>"

hostname:pn-base-files = "nao"

LICENSE_FLAGS_ACCEPTED = "commercial"

PREFERRED_PROVIDER_virtual/kernel = "linux-intel-rt"
PREFERRED_PROVIDER_cgos-mod = "linux-intel-rt"

OS_RELEASE_FIELDS:append = " BUILD_ID"

IMAGE_NAME = "${IMAGE_BASENAME}-${DISTRO}-${DISTRO_VERSION}${IMAGE_VERSION_SUFFIX}"
IMAGE_LINK_NAME = "${IMAGE_BASENAME}-${DISTRO}-${DISTRO_VERSION}"

DISTRO_FEATURES:remove = "x11 wayland 3g nfs nfc opengl vulkan bluetooth pcmcia"

DISTRO_FEATURES:append = " pam polkit"

KERNEL_MODULE_AUTOLOAD:append = " cgosdrv"

DISTRO_FEATURES:append = " systemd usrmerge"
VIRTUAL-RUNTIME_init_manager = "systemd"
DISTRO_FEATURES_BACKFILL_CONSIDERED = "sysvinit"
VIRTUAL-RUNTIME_initscripts = ""

VIRTUAL-RUNTIME_base-utils = "packagegroup-core-base-utils"
```

## conf/distro/nao-multilib.conf
```bitbake
require conf/distro/poky.conf

DISTRO = "nao-multilib"
DISTRO_NAME = "nao-multilib"
DISTRO_VERSION = "0.5"
SDK_NAME = "${DISTRO}"
SDKPATHINSTALL = "/opt/${DISTRO}/${SDK_VERSION}"

hostname:pn-base-files = "nao"

LICENSE_FLAGS_WHITELIST = "commercial"

PREFERRED_PROVIDER_virtual/kernel = "linux-intel-rt"
PREFERRED_VERSION_linux-intel-rt = "5.4%"
PREFERRED_PROVIDER_cgos-mod = "linux-intel-rt"
PREFERRED_PROVIDER_lib32-cgos-mod = "linux-intel-rt"

OS_RELEASE_FIELDS += "BUILD_ID"

IMAGE_NAME = "${IMAGE_BASENAME}-${DISTRO}-${DISTRO_VERSION}${IMAGE_VERSION_SUFFIX}"
IMAGE_LINK_NAME = "${IMAGE_BASENAME}-${DISTRO}-${DISTRO_VERSION}"

DISTRO_FEATURES:remove = "x11 wayland 3g nfs nfc opengl vulkan bluetooth pcmcia"

DISTRO_FEATURES += "pam polkit"

KERNEL_MODULE_AUTOLOAD += "cgosdrv"

DISTRO_FEATURES:append = " systemd"
VIRTUAL-RUNTIME_init_manager = "systemd"
DISTRO_FEATURES_BACKFILL_CONSIDERED += "sysvinit"
VIRTUAL-RUNTIME_initscript = "systemd-compat-units"

require conf/multilib.conf
MULTILIBS = "multilib:lib32"
DEFAULTTUNE:virtclass-multilib-lib32 = "x86"
```

## conf/layer.conf
```bitbake
# We have a conf and classes directory, add to BBPATH
BBPATH .= ":${LAYERDIR}"

# We have recipes-* directories, add to BBFILES
BBFILES += "${LAYERDIR}/recipes-*/*/*.bb \
${LAYERDIR}/recipes-*/*/*.bbappend"

LAYERSERIES_COMPAT_nao = "dunfell hardknott"

BBFILE_COLLECTIONS += "nao"
BBFILE_PATTERN_nao = "^${LAYERDIR}/"
BBFILE_PRIORITY_nao = "8"
LAYERVERSION_nao = "4"
```

## conf/machine/nao-v6.conf
```bitbake
# Machine configuration for the NAO robot version 6

MACHINEOVERRIDES =. "congatec-qa3-64:"

require conf/machine/include/congatec-common-64.inc

IMAGE_FSTYPES = "ext4.gz.opn"
IMAGE_CLASSES += "image_opn"
```

## meta-hulks/conf/distro/HULKs-OS.conf
```bitbake
require conf/distro/nao-core-minimal.conf

SUMMARY = "HULKs flavoured Nao"

DISTRO = "HULKs-OS"
DISTRO_NAME = "HULKs-OS"
DISTRO_VERSION = "9.0.0"
SDKIMAGE_FEATURES:remove = "dbg-pkgs src-pkgs"
```

## meta/conf/distro/nao-core-minimal.conf
```bitbake
SUMMARY = "A small image just capable of allowing a device to boot."

DISTRO = "nao-core-minimal"
DISTRO_NAME = "nao-core-minimal"
DISTRO_VERSION = "3.0"
TARGET_VENDOR = "-aldebaran"
IMAGE_NAME = "${IMAGE_BASENAME}-${DISTRO}-${DISTRO_VERSION}${IMAGE_VERSION_SUFFIX}"
IMAGE_LINK_NAME = "${IMAGE_BASENAME}-${DISTRO}-${DISTRO_VERSION}"
SDK_NAME = "${DISTRO}-${SDKMACHINE}"
SDK_VENDOR = "-naosdk"
SDK_ARCHIVE_TYPE = "tar.zst"
MAINTAINER = "Team HULKs <hulks@tuhh.de>"

# TODO: maybe: ipv6
DISTRO_FEATURES ?= "alsa ext2 ipv4 usbgadget usbhost wifi xattr pci vfat pam polkit pulseaudio ldconfig"

DISTRO_EXTRA_RDEPENDS += "packagegroup-core-boot"

PREFERRED_PROVIDER_virtual/kernel = "linux-intel-rt"

PREFERRED_PROVIDER_cgos-mod = "linux-intel-rt"
KERNEL_MODULE_AUTOLOAD:append = " cgosdrv"

PACKAGE_CLASSES ?= "package_ipk"

require conf/distro/include/no-static-libs.inc

BB_SIGNATURE_HANDLER ?= "OEEquivHash"
BB_HASHSERVE ??= "auto"

INIT_MANAGER = "systemd"

hostname:pn-base-files = "nao"
```
